## boards/shields/single_key/Kconfig.shield
```kconfig
# Copyright (c) 2022 The ZMK Contributors
# SPDX-License-Identifier: MIT

config SHIELD_SINGLE_KEY
    def_bool $(shields_list_contains,single_key)
```

## boards/shields/west.yml
```yaml
manifest:
  remotes:
  - name: zmkfirmware
    url-base: https://github.com/zmkfirmware
  - name: nickconway
    #Use branch smart-interrupt
    url-base: https://github.com/nickconway
  - name: caksoylar
    #Use branch caksoylar/experimental
    url-base: https://github.com/caksoylar
  - name: ulmanyar
    url-base: https://github.com/ulmanyar
  - name: petejohanson
    url-base: https://github.com/petejohanson
  projects:
  - name: zmk
    remote: petejohanson
    revision: feat/pointers-move-scroll
    import: app/west.yml
  - name: zmk-analog-input-driver
    remote: badjeff
    revision: main
  self:
    path: config
```
